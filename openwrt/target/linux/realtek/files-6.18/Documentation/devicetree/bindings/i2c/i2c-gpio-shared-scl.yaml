## openwrt/target/linux/realtek/files-6.18/Documentation/devicetree/bindings/i2c/i2c-gpio-shared-scl.yaml
```yaml
# SPDX-License-Identifier: (GPL-2.0-only OR BSD-2-Clause)
%YAML 1.2
---
$id: http://devicetree.org/schemas/i2c/i2c-gpio-shared-scl.yaml#
$schema: http://devicetree.org/meta-schemas/core.yaml#

title: Bit-banged I2C buses sharing one SCL line

maintainers:
  - OpenWrt contributors

description: |
  Several I2C buses bit-banged on GPIOs, with one SCL line common to all of
  them and one SDA line per bus. Each child node is a separate I2C bus.
  Transfers are serialized, so only one bus clocks SCL at a time.

properties:
  compatible:
    const: i2c-gpio-shared-scl

  scl-gpios:
    description: The shared SCL line, usually open drain.
    maxItems: 1

  i2c-gpio,delay-us:
    description: Half the clock period in microseconds, as for i2c-gpio.
    default: 5

  i2c-gpio,timeout-ms:
    description: Clock stretching timeout in milliseconds, as for i2c-gpio.
    default: 100

  "#address-cells":
    const: 1

  "#size-cells":
    const: 0

patternProperties:
  "^i2c@[0-9a-f]+$":
    $ref: /schemas/i2c/i2c-controller.yaml#
    unevaluatedProperties: false

    properties:
      reg:
        description: Index of the bus, for naming only.
        maxItems: 1

      sda-gpios:
        description: The SDA line of this bus, usually open drain.
        maxItems: 1

    required:
      - reg
      - sda-gpios

required:
  - compatible
  - scl-gpios
  - "#address-cells"
  - "#size-cells"

additionalProperties: false

examples:
  - |
    #include <dt-bindings/gpio/gpio.h>

    i2c-gpio-shared {
        compatible = "i2c-gpio-shared-scl";
        scl-gpios = <&gpio0 8 (GPIO_ACTIVE_HIGH | GPIO_OPEN_DRAIN)>;
        i2c-gpio,delay-us = <5>;
        #address-cells = <1>;
        #size-cells = <0>;

        i2c@0 {
            reg = <0>;
            sda-gpios = <&gpio0 9 (GPIO_ACTIVE_HIGH | GPIO_OPEN_DRAIN)>;
            #address-cells = <1>;
            #size-cells = <0>;

            fan-controller@2e {
                compatible = "adi,adt7476";
                reg = <0x2e>;
            };
        };

        i2c@1 {
            reg = <1>;
            sda-gpios = <&gpio0 10 (GPIO_ACTIVE_HIGH | GPIO_OPEN_DRAIN)>;
            #address-cells = <1>;
            #size-cells = <0>;
        };
    };
```

## openwrt/target/linux/realtek/files-6.18/Documentation/devicetree/bindings/leds/realtek,rtl9300-port-leds.yaml
```yaml
# SPDX-License-Identifier: (GPL-2.0-only OR BSD-2-Clause)
%YAML 1.2
---
$id: http://devicetree.org/schemas/leds/realtek,rtl9300-port-leds.yaml#
$schema: http://devicetree.org/meta-schemas/core.yaml#

title: Realtek RTL9300 switch port LEDs under software control

maintainers:
  - OpenWrt Developers <openwrt-devel@lists.openwrt.org>

description: |
  The RTL9300 switch drives up to four LEDs per port over its serial LED
  interface, each normally showing a hardware function chosen by the LED set
  of the port. The LEDs listed here are taken over by software instead and
  switched on and off as LED class devices, for port LEDs that have no
  hardware function such as the PoE status LED of a PoE switch. The node is
  a child of the switch, whose registers it uses.

properties:
  compatible:
    const: realtek,rtl9300-port-leds

  "#address-cells":
    const: 2

  "#size-cells":
    const: 0

patternProperties:
  "^led@[0-9a-f]+,[0-3]$":
    $ref: /schemas/leds/common.yaml#
    unevaluatedProperties: false

    properties:
      reg:
        items:
          - items:
              - description: Switch port
                maximum: 27
              - description: LED of the port, 0 being the first in the
                  serial LED stream
                maximum: 3

    required:
      - reg

required:
  - compatible
  - "#address-cells"
  - "#size-cells"

additionalProperties: false

examples:
  - |
    #include <dt-bindings/leds/common.h>

    port-leds {
        compatible = "realtek,rtl9300-port-leds";
        #address-cells = <2>;
        #size-cells = <0>;

        led@0,2 {
            reg = <0 2>;
            color = <LED_COLOR_ID_GREEN>;
            function = "poe";
            function-enumerator = <1>;
        };

        led@8,2 {
            reg = <8 2>;
            color = <LED_COLOR_ID_GREEN>;
            function = "poe";
            function-enumerator = <2>;
        };
    };
```

## openwrt/target/linux/realtek/files-6.18/Documentation/devicetree/bindings/leds/realtek,rtl9301-port-leds.yaml
```yaml
# SPDX-License-Identifier: (GPL-2.0-only OR BSD-2-Clause)
%YAML 1.2
---
$id: http://devicetree.org/schemas/leds/realtek,rtl9301-port-leds.yaml#
$schema: http://devicetree.org/meta-schemas/core.yaml#

title: Realtek RTL9300 switch port LEDs under software control

maintainers:
  - OpenWrt Developers <openwrt-devel@lists.openwrt.org>

description: |
  The RTL9300 switch drives up to four LEDs per port over its LED interface,
  serial or scanned, each normally showing a hardware function chosen by the
  LED set of the port. The LEDs listed here are taken over by software instead
  and switched on and off as LED class devices, for port LEDs that have no
  hardware function such as the PoE status LED of a PoE switch. The node is a
  child of the switch, whose registers it uses.

properties:
  compatible:
    const: realtek,rtl9301-port-leds

  reg:
    description: The software LED control registers, from SW_LED_LOAD to the
      end of LED_PORT_SW_CTRL, as an offset into the switch registers.
    maxItems: 1

  "#address-cells":
    const: 2

  "#size-cells":
    const: 0

patternProperties:
  "^led@[0-9a-f]+,[0-3]$":
    $ref: /schemas/leds/common.yaml#
    unevaluatedProperties: false

    properties:
      reg:
        items:
          - items:
              - description: Switch port
                maximum: 27
              - description: LED of the port, numbered as in the port's
                  LED set
                maximum: 3

    required:
      - reg

required:
  - compatible
  - reg
  - "#address-cells"
  - "#size-cells"

additionalProperties: false

examples:
  - |
    #include <dt-bindings/leds/common.h>

    led-controller@cc48 {
        compatible = "realtek,rtl9301-port-leds";
        reg = <0xcc48 0x84>;
        #address-cells = <2>;
        #size-cells = <0>;

        led@0,2 {
            reg = <0 2>;
            color = <LED_COLOR_ID_GREEN>;
            function = "poe";
            function-enumerator = <1>;
        };

        led@8,2 {
            reg = <8 2>;
            color = <LED_COLOR_ID_GREEN>;
            function = "poe";
            function-enumerator = <2>;
        };
    };
```
